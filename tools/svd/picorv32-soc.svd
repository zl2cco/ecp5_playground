# PicoRV32-SOC register map
Vendor: 1BitSquared
Registers are 32-bit, read-write, reset 0x0 unless marked. A register's access mark holds for its fields unless they carry their own. Offsets are from the block's base; lines under a group give offsets from that group; [hi:lo] are bit positions; {n}, {i} and the like mark numbered series; 'fields as' and 'values as' point back to an identical list; <NAME> marks a mode.

## Memory map
0x02000000 UART size 0x10 — UART interface
0x02000000 LED size 0x1 — LED control

## UART — UART interface
Base 0x02000000
0x04 CSR reset 0x1B2 — UART Config and Status Register
  [31:0] DIV — Baud rate clock divider
0x08 DATA — UART data in/out register. HSB 0 indicates pending data.
  [7:0] DATABYTE — The actual data input and output.

## LED — LED control
Base 0x02000000
0x00 CSR — Control and Status Register
  [0] LED0 — Output to LED. 0 off, 1 on
